## Tests/test4-http-download/Kconfig.projbuild.test4
```kconfig
menu "SafeLink Test 4"

config SAFELINK_WIFI_SSID
    string "Wi-Fi network name (SSID)"
    default ""
    help
        Network used by the Windows SafeLink download server and ESP32-C6.

config SAFELINK_WIFI_PASSWORD
    string "Wi-Fi password"
    default ""
    help
        Stored in the local sdkconfig and compiled test firmware. Do not put
        the configured sdkconfig into a public repository.

config SAFELINK_SERVER_HOST
    string "SafeLink server IPv4 address"
    default "192.168.0.189"

config SAFELINK_SERVER_PORT
    int "SafeLink server TCP port"
    range 1 65535
    default 8000

endmenu
```
